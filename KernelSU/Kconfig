## KernelSU/Kconfig
```kconfig
config KSU_SUSFS
	bool "Enable SuSFS (Suspicious FS)"
	default y
	help
	  Enable SuSFS support for hiding files and processes.

config KSU_SUSFS_HAS_MAGIC_MOUNT
	bool "SuSFS has Magic Mount support"
	depends on KSU_SUSFS
	default y

config KSU_SUSFS_SUS_PATH
	bool "Enable sus_path"
	depends on KSU_SUSFS
	default y

config KSU_SUSFS_SUS_KSTAT
	bool "Enable sus_kstat"
	depends on KSU_SUSFS
	default y

config KSU_SUSFS_SUS_OVERLAYFS
	bool "Enable sus_overlayfs"
	depends on KSU_SUSFS
	default y

config KSU_SUSFS_TRY_UMOUNT
	bool "Enable try_umount"
	depends on KSU_SUSFS
	default y

config KSU_SUSFS_SPOOF_UNAME
	bool "Enable uname spoofing"
	depends on KSU_SUSFS
	default y

config KSU_SUSFS_ENABLE_LOG
	bool "Enable SuSFS logging"
	depends on KSU_SUSFS
	default n

config KSU_SUSFS_HIDE_KSU_SUSFS_SYMBOLS
	bool "Hide KSU/SuSFS symbols from kallsyms"
	depends on KSU_SUSFS
	default y

config KSU_SUSFS_SPOOF_CMDLINE_OR_BOOTCONFIG
	bool "Enable cmdline/bootconfig spoofing"
	depends on KSU_SUSFS
	default y

config KSU_SUSFS_OPEN_REDIRECT
	bool "Enable open_redirect"
	depends on KSU_SUSFS
	default y

config KSU_SUSFS_SUS_MOUNT
	bool "Enable sus_mount"
	depends on KSU_SUSFS
	default y

config KSU_SUSFS_AUTO_ADD_SUS_KSU_DEFAULT_MOUNT
	bool "Auto add sus mount for KSU default mount"
	depends on KSU_SUSFS_SUS_MOUNT
	default y

config KSU_SUSFS_AUTO_ADD_SUS_BIND_MOUNT
	bool "Auto add sus mount for bind mount"
	depends on KSU_SUSFS_SUS_MOUNT
	default y

config KSU_SUSFS_AUTO_ADD_TRY_UMOUNT_FOR_BIND_MOUNT
	bool "Auto add try_umount for bind mount"
	depends on KSU_SUSFS_TRY_UMOUNT
	default y

config KSU_SUSFS_SUS_SU
	bool "Enable sus_su (deprecated)"
	depends on KSU_SUSFS
	default n
```
